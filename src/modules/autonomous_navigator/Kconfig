## src/modules/autonomous_navigator/Kconfig
```kconfig
menuconfig MODULES_AUTONOMOUS_NAVIGATOR
	bool "autonomous_navigator"
	default n
	---help---
		Enable support for autonomous_navigator
```

## src/modules/crosswind_compensator/Kconfig
```kconfig
menuconfig MODULES_CROSSWIND_COMPENSATOR
	bool "crosswind_compensator"
	default n
	---help---
		Enable support for crosswind_compensator
```
